## drivers/phoenix/GP712drv/Kconfig
```kconfig
config GP712
        tristate "Greenpeak 712"
        default m
        ---help---
          Help message of GP712
```

## drivers/phoenix/Kconfig
```kconfig
source "drivers/phoenix/rtl8821au/Kconfig"

source "drivers/phoenix/GP712drv/Kconfig"

source "drivers/phoenix/rtk_btusb/Kconfig"
```

## drivers/phoenix/rtk_btusb/Kconfig
```kconfig
config RTK_BTUSB
        tristate "Realtek BT USB"
        depends on USB
        ---help---
          Help message of RTK_BTUSB
```
